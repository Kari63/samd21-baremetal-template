#include "samd21.h"
#include "adc_init.h"
#include "dma.h"

static inline void adc_sync(void)
{
	while (ADC->STATUS.bit.SYNCBUSY);
}

void adc_init(void)
{
	/* 1) Enable the bus clock */
	PM->APBCMASK.reg |= PM_APBCMASK_ADC;

	/* 2) Connect GCLK0 (48 MHz) */
	GCLK->CLKCTRL.reg =
	GCLK_CLKCTRL_ID_ADC |
	GCLK_CLKCTRL_GEN_GCLK0 |
	GCLK_CLKCTRL_CLKEN;
	while (GCLK->STATUS.bit.SYNCBUSY);

	// Clear a possible SWRST hang (0x02) first
	ADC->CTRLA.reg = 0;
	adc_sync();
	
	
	

	/* 3) SAMD21 factory calibration (0x00806020) */
	uint32_t w0 = *(volatile const uint32_t *)0x00806020;
	uint32_t w1 = *(volatile const uint32_t *)0x00806024;
	uint32_t linearity = ((w0 >> 27) & 0x1F) | ((w1 & 0x7) << 5);
	uint32_t bias      = (w1 >> 3) & 0x7;
	
	ADC->CALIB.reg =
	ADC_CALIB_BIAS_CAL(bias) |
	ADC_CALIB_LINEARITY_CAL(linearity);

	/* 4) Resolution (12-bit) and a stable clock (48 MHz / 32 = 1.5 MHz) */
	adc_sync();
	ADC->CTRLB.reg = ADC_CTRLB_RESSEL_12BIT | ADC_CTRLB_PRESCALER_DIV32;

	/* 5) Reference */
	adc_sync();
	ADC->REFCTRL.reg = ADC_REFCTRL_REFSEL_INTVCC1;

	/* 6) Channel select: MUXPOS=0 (AIN0), MUXNEG=0x18 (IOMUX_PAD_N) */
	adc_sync();
	ADC->INPUTCTRL.reg =
	ADC_INPUTCTRL_MUXPOS_PIN0 |
	(0x18 << ADC_INPUTCTRL_MUXNEG_Pos) | // forces the 0x1800 setting
	ADC_INPUTCTRL_GAIN_DIV2;
	adc_sync();
	// The ADC listens to the EVSYS START event generated by TC3.
	ADC->EVCTRL.reg = ADC_EVCTRL_STARTEI;

	/* 7) Pinmux PA02 (pin 2, group 0) as analog */
	PORT->Group[0].PINCFG[2].bit.PMUXEN = 1;
	PORT->Group[0].PMUX[2 >> 1].bit.PMUXE = PORT_PMUX_PMUXE_B;

	/* 8) Enable the ADC (ENABLE = 1) */
	adc_sync();
	ADC->CTRLA.bit.ENABLE = 1;
	adc_sync();

	/* 9) Settling delay */
	for (volatile int i = 0; i < 500; i++) {}

	/* 10) Dummy conversion for stability */
	adc_sync();
	ADC->SWTRIG.bit.START = 1;
	adc_sync();
	while (!ADC->INTFLAG.bit.RESRDY);

	(void)ADC->RESULT.reg; // discard the result before enabling the trigger
	ADC->INTFLAG.reg = ADC_INTFLAG_RESRDY;
	// RESRDY does not go to the ADC IRQ; it triggers the ADC DMA channel.
	ADC->INTENCLR.reg = ADC_INTENCLR_RESRDY;
	dmac_build_channel_adc_ping_pong();
	dmac_arm_channel_adc_trigger();
}
