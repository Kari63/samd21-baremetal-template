#include "samd21.h"
#include "sercom_init.h"
//#include "sercom4_init.h"

void sercom4_init(void)
{
	SERCOM4->USART.CTRLA.bit.ENABLE = 0;
	while (SERCOM4->USART.SYNCBUSY.bit.ENABLE);

	PM->APBCMASK.reg |= PM_APBCMASK_SERCOM4;

	GCLK->CLKCTRL.reg = (uint16_t)(
	GCLK_CLKCTRL_ID(SERCOM4_GCLK_ID_CORE) |
	GCLK_CLKCTRL_GEN_GCLK0 |
	GCLK_CLKCTRL_CLKEN
	);

	SERCOM4->USART.CTRLA.bit.SWRST = 1;
	while (SERCOM4->USART.SYNCBUSY.bit.SWRST);

	PORT->Group[1].PINCFG[10].bit.PMUXEN = 1;
	PORT->Group[1].PINCFG[11].bit.PMUXEN = 1;

	PORT->Group[1].PMUX[10 >> 1].reg =
	PORT_PMUX_PMUXE_D | PORT_PMUX_PMUXO_D;

	SERCOM4->USART.CTRLA.reg =
	SERCOM_USART_CTRLA_MODE_USART_INT_CLK |
	SERCOM_USART_CTRLA_RXPO(3) |
	SERCOM_USART_CTRLA_TXPO(1) |
	SERCOM_USART_CTRLA_DORD;

	SERCOM4->USART.CTRLB.reg =
	SERCOM_USART_CTRLB_RXEN |
	SERCOM_USART_CTRLB_TXEN;
	while (SERCOM4->USART.SYNCBUSY.bit.CTRLB);

	SERCOM4->USART.BAUD.reg = 63018 ;                  // 65326;

	SERCOM4->USART.CTRLA.bit.ENABLE = 1;
	while (SERCOM4->USART.SYNCBUSY.bit.ENABLE);

	//SERCOM4->USART.INTENSET.bit.RXC = 1;
	// SERCOM4->USART.INTENSET.bit.DRE = 1;
	SERCOM4->USART.INTENSET.reg = SERCOM_USART_INTENSET_RXC | SERCOM_USART_INTENSET_TXC;

	NVIC_EnableIRQ(SERCOM4_IRQn);
	NVIC_SetPriority(SERCOM4_IRQn, 2);
}
