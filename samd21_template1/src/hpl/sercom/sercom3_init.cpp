/*
 * sercom3_init.cpp - SERCOM3 USART = console on the EDBG virtual COM port
 * SAMD21 Xplained Pro: the EDBG CDC (USB debug cable, Windows "EDBG Virtual
 * COM Port") is wired to PA22 = SAMD21 TX (PAD0) and PA23 = SAMD21 RX (PAD1),
 * function C. 115200 8N1. The EDBG forwards data only when the PC sets DTR
 * (PuTTY does by default). Formerly the console was SERCOM4 (HC-05).
 */
#include "samd21.h"
#include "sercom_init.h"

void sercom3_init(void)
{
	SERCOM3->USART.CTRLA.bit.ENABLE = 0;
	while (SERCOM3->USART.SYNCBUSY.bit.ENABLE);

	PM->APBCMASK.reg |= PM_APBCMASK_SERCOM3;

	GCLK->CLKCTRL.reg = (uint16_t)(
	GCLK_CLKCTRL_ID(SERCOM3_GCLK_ID_CORE) |
	GCLK_CLKCTRL_GEN_GCLK0 |
	GCLK_CLKCTRL_CLKEN
	);

	SERCOM3->USART.CTRLA.bit.SWRST = 1;
	while (SERCOM3->USART.SYNCBUSY.bit.SWRST);

	PORT->Group[0].PINCFG[22].bit.PMUXEN = 1;
	PORT->Group[0].PINCFG[23].bit.PMUXEN = 1;

	PORT->Group[0].PMUX[22 >> 1].reg =
	PORT_PMUX_PMUXE_C | PORT_PMUX_PMUXO_C;

	SERCOM3->USART.CTRLA.reg =
	SERCOM_USART_CTRLA_MODE_USART_INT_CLK |
	SERCOM_USART_CTRLA_RXPO(1) |        // RX = PAD1 (PA23)
	SERCOM_USART_CTRLA_TXPO(0) |        // TX = PAD0 (PA22)
	SERCOM_USART_CTRLA_DORD;

	SERCOM3->USART.CTRLB.reg =
	SERCOM_USART_CTRLB_RXEN |
	SERCOM_USART_CTRLB_TXEN;
	while (SERCOM3->USART.SYNCBUSY.bit.CTRLB);

	SERCOM3->USART.BAUD.reg = 63018 ;                  // 65326;

	SERCOM3->USART.CTRLA.bit.ENABLE = 1;
	while (SERCOM3->USART.SYNCBUSY.bit.ENABLE);

	//SERCOM3->USART.INTENSET.bit.RXC = 1;
	// SERCOM3->USART.INTENSET.bit.DRE = 1;
	SERCOM3->USART.INTENSET.reg = SERCOM_USART_INTENSET_RXC | SERCOM_USART_INTENSET_TXC;

	NVIC_EnableIRQ(SERCOM3_IRQn);
	NVIC_SetPriority(SERCOM3_IRQn, 2);
}
